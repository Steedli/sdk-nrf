## samples/dfu/upgradable_mcuboot_tfm_smp_svr/sysbuild/mcuboot/boards/nrf54lm20dk_nrf54lm20a_cpuapp.conf
```kconfig
CONFIG_PM_PARTITION_SIZE_MCUBOOT=0x13800

# Keep MCUboot small enough for the S0/S1 update slots on nRF54LM20A.
CONFIG_SPI_NOR=n
CONFIG_FPROTECT=n
CONFIG_BOOT_WATCHDOG_FEED=n
CONFIG_MAIN_STACK_SIZE=12288

CONFIG_FLASH=y
CONFIG_BOOT_MAX_IMG_SECTORS=256
CONFIG_MULTITHREADING=y

CONFIG_LOG=y
CONFIG_LOG_MODE_MINIMAL=y
CONFIG_LOG_DEFAULT_LEVEL=0
CONFIG_MCUBOOT_LOG_LEVEL_INF=y
CONFIG_CBPRINTF_NANO=y
CONFIG_MINIMAL_LIBC=y

CONFIG_FW_INFO_FIRMWARE_VERSION=2
CONFIG_NCS_APPLICATION_BOOT_BANNER_STRING="MCUboot"
```
