## samples/gppi_muticore_timer130/boards/nrf54h20dk_nrf54h20_cpuapp.conf
```kconfig
# CONFIG_NRFX_TIMER130=y
# CONFIG_NRFX_TIMER131=y
# CONFIG_NRF_REGTOOL_VERBOSITY=2
CONFIG_SOC_NRF54H20_CPURAD_ENABLE=y
```
